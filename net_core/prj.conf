## CMakeLists.txt
```
cmake_minimum_required(VERSION 3.8.2)

set(BOARD nrf5340dk_nrf5340_cpunet)

list(APPEND ZEPHYR_EXTRA_MODULES ${CMAKE_SOURCE_DIR}/../message/)

find_package(Zephyr REQUIRED HINTS $ENV{ZEPHYR_BASE})
project(NONE)

target_include_directories(app PRIVATE
    include
    ../include
)
FILE(GLOB app_sources src/*.c)
target_sources(app PRIVATE
    ${app_sources}
)
```

## prj.conf
```kconfig
# NRFX
CONFIG_NRFX_POWER=y
CONFIG_NRFX_CLOCK=y
CONFIG_NRFX_TIMER0=y

# Logging
CONFIG_LOG=y

# IPC
CONFIG_RPMSG_SERVICE=y
CONFIG_RPMSG_SERVICE_MODE_REMOTE=y
CONFIG_HEAP_MEM_POOL_SIZE=512
```

## src/main.c
```c
#include <stdio.h>

#include <stdbool.h>
#include <stddef.h>
#include <stdint.h>

#include <logging/log.h>
#include <logging/log_ctrl.h>
#include <zephyr.h>

#include <nrfx.h>
#include <nrfx_clock.h>
#include <nrfx_power.h>

#include <common.h>
#include <message.h>

#include <ipc.h>
#include <node.h>
#include <radio.h>

LOG_MODULE_REGISTER(main, GLOBAL_LOG_LEVEL);

/**
 * @brief Initialize power and clock peripherals
 */
static void init_power_clock(void)
{
    nrfx_clock_init(NULL);
    nrfx_power_init(NULL);
    nrfx_clock_start(NRF_CLOCK_DOMAIN_HFCLK);
    nrfx_clock_start(NRF_CLOCK_DOMAIN_LFCLK);
    while (!(nrfx_clock_hfclk_is_running() &&
             nrfx_clock_lfclk_is_running()))
    {
        /* Just waiting */
    }
}

void main(void)
{
    /* NRFX init */
    init_power_clock();
    LOG_INF("Power and clock initialized");

    /* Radio init */
    init_radio();
    LOG_INF("Radio initialized");

    /* Node init */
    init_node();
    LOG_INF("Node initialized");

    LOG_INF("Mesh node on network core started.");

    k_msleep(2000); // Allow logs time to flush
}

/**
 * @brief Callback for received radio frames
 */
void radio_receive_cb(struct message *msg)
{
    node_enqueue(msg);
}

/**
 * @brief Callback for received IPC messages
 *
 * Forward messages to mesh network
 */
void ipc_receive_cb(struct message *msg)
{
    if (msg->payload_len > MAX_PAYLOAD_SIZE)
    {
        LOG_ERR("IPC message too large: %d", msg->payload_len);
        return;
    }
    LOG_DBG("ipc_receive_cb()");
    int ret = node_send(msg);
    if (ret != 0)
    {
        LOG_ERR("Node send failed with: %d", ret);
    }
}

void node_receive(struct message *msg)
{
    LOG_HEXDUMP_DBG(msg->payload, msg->payload_len, "Node RX data");
    int ret = ipc_send(msg);
    if (ret < 0)
    {
        LOG_ERR("IPC send failed with %d", ret);
    }
}
```

## include/common.h
```c
#define GLOBAL_LOG_LEVEL LOG_LEVEL_INF

#define MAX_MESSAGE_SIZE 255
```

## include/hash.h
```c
/**
 * @brief Get the hash for a packet.
 * 
 * @details Only the fields that don't change between hops is included in the
 *          hash. This allows the same original packet to have the same hash
 *          even when the source MAC and TTl has changed.
 */
uint32_t hash_packet(struct message *msg);

/**
 * @brief Initialize hash
 */
void init_hash();

/**
 * @brief Add a hash to the hashset, and remove old hashes if it is full.
 */
void hash_add(uint32_t hash);

/**
 * @brief Check if a given hash is already in the set.
 */
bool hash_contains(uint32_t hash_val);
```

## include/ipc.h
```c
/**
 * @brief Send message to other core with IPC
 */
int ipc_send(struct message *msg);

/**
 * @brief IPC receive callback
 */
void ipc_receive_cb(struct message *msg);
```

## include/msg.h
```c
/**
 * @brief Mesh message struct
 */
struct mesh_msg
{
    size_t len;
    uint8_t *data;
};
```

## include/node.h
```c
#define MAX_HASH_COUNT_LIMIT 100

/**
 * @brief Add a message to a queue so that it can be procecedd later.
 */
void node_enqueue(struct message *msg);

/**
 * @brief Send a messsage over the radio with an added header.
 */
int node_send(struct message *msg);

/**
 * @brief Node receive callback.
 */
void node_receive(struct message *msg);

/**
 * @brief Node processing thread.
 */
void node_thread(void *p1, void *p2, void *p3);

/**
 * @brief Initialize node
 */
void init_node();
```

## include/radio.h
```c
/**
 * @brief Initialize radio
 */
void init_radio();

/**
 * @brief Start radio transmission
 */
int radio_send(uint8_t *data, size_t length);

/**
 * @brief Radio receive callback function. 
 * 
 * @details This function must be implemented by the module making use of the radio. It will be called 
 *      when the radio has received a frame. The data buffer may be overwritten at any time after this
 *      function returns, so data should be copied to another buffer or processing should be completed
 *      before returning.
 */
void radio_receive_cb(struct message *msg);
```

## src/hash.c
```c
#include <stdint.h>
#include <stdio.h>

#include <common.h>
#include <message.h>

#include <node.h>

#include <logging/log.h>
#include <logging/log_ctrl.h>
#include <zephyr.h>
LOG_MODULE_REGISTER(hash, GLOBAL_LOG_LEVEL);

#define NUM_BUCKETS (MAX_HASH_COUNT_LIMIT / 2)

struct node
{
    uint32_t data;
    struct node *next;
};

struct node *buckets[NUM_BUCKETS];
size_t hash_size = 0;

// TODO Find out why this is too small without the constant.
K_HEAP_DEFINE(hash_heap, sizeof(struct node) * MAX_HASH_COUNT_LIMIT * 8);

K_MUTEX_DEFINE(hash_mutex);

uint32_t queue[MAX_HASH_COUNT_LIMIT];
size_t queue_back = MAX_HASH_COUNT_LIMIT - 1;
size_t queue_front = 0;
size_t queue_size = 0;

void enqueue(uint32_t hash_val)
{
    if (queue_size == MAX_HASH_COUNT_LIMIT)
    {
        LOG_ERR("Queue Full!");
        return;
    }
    queue_back = (queue_back + 1) % MAX_HASH_COUNT_LIMIT;
    queue[queue_back] = hash_val;
    queue_size++;
}

uint32_t dequeue()
{
    if (queue_size == 0)
    {
        LOG_ERR("Nothing to dequeue");
        return 0;
    }
    uint32_t hash_val = queue[queue_front];
    queue_front = (queue_front + 1) % MAX_HASH_COUNT_LIMIT;
    queue_size--;
    return hash_val;
}

/* Based on djb2 */
uint32_t hash_packet(struct message *msg)
{
    uint32_t hash = 5381;

    for (size_t i = 0; i < MAC_LEN; i++)
    {
        hash += (hash << 5) + msg->src_mac[i];
    }
    for (size_t i = 0; i < MAC_LEN; i++)
    {
        hash += (hash << 5) + msg->dst_mac[i];
    }
    hash += (hash << 5) + msg->msg_number;
    hash += (hash << 5) + msg->payload_len;
    for (size_t i = 0; i < msg->payload_len; i++)
    {
        hash += (hash << 5) + msg->payload[i];
    }

    return hash;
}

void init_hash()
{
    for (size_t i = 0; i < NUM_BUCKETS; i++)
    {
        buckets[i] = NULL;
    }
}

void hash_remove(uint32_t hash_val)
{
    uint32_t bucket = hash_val % NUM_BUCKETS;
    if (buckets[bucket] == NULL)
        return;

    if (buckets[bucket]->data == hash_val)
    {
        buckets[bucket] = buckets[bucket]->next;
        return;
    }
    for (struct node *x = buckets[bucket]; x->next != NULL; x = x->next)
    {
        if (x->next->data == hash_val)
        {
            struct node *old_ptr = x->next;
            x->next = x->next->next;
            k_heap_free(&hash_heap, old_ptr);
            hash_size--;
            return;
        }
    }
}

/* Assumes that there isn't already an equal key in the set. This holds for the
 * mesh node since every packet is first checked if they're a member of the set.
 */
void hash_add(uint32_t hash_val)
{
    k_mutex_lock(&hash_mutex, K_FOREVER);
    while (hash_size >= MAX_HASH_COUNT_LIMIT)
    {
        uint32_t old_hash = dequeue();
        hash_remove(old_hash);
    }
    enqueue(hash_val);
    uint32_t bucket = hash_val % NUM_BUCKETS;
    void *ptr = k_heap_alloc(&hash_heap, sizeof(struct node), K_NO_WAIT);
    if (ptr == NULL)
    {
        LOG_ERR("Failed to allocate memory in heap.");
        return;
    }
    struct node *new_node = (struct node *)ptr;
    new_node->data = hash_val;
    new_node->next = buckets[bucket];
    buckets[bucket] = new_node;
    hash_size++;
    k_mutex_unlock(&hash_mutex);
}

bool hash_contains(uint32_t hash_val)
{
    uint32_t bucket = hash_val % NUM_BUCKETS;
    for (struct node *x = buckets[bucket]; x != NULL; x = x->next)
    {
        if (x->data == hash_val)
        {
            return true;
        }
    }
    return false;
}
```

## src/ipc.c
```c
#include <stdbool.h>
#include <stddef.h>
#include <stdint.h>
#include <stdio.h>

#include <arch/cpu.h>
#include <drivers/ipm.h>
#include <logging/log.h>
#include <sys/byteorder.h>
#include <zephyr.h>

#include <logging/log.h>
#include <logging/log_ctrl.h>
#include <sys/util.h>

#include <metal/alloc.h>
#include <metal/device.h>
#include <metal/sys.h>
#include <openamp/open_amp.h>

#include <ipc/rpmsg_service.h>

#include <common.h>
#include <message.h>

#include <ipc.h>

LOG_MODULE_REGISTER(ipc, GLOBAL_LOG_LEVEL);

uint8_t ipc_send_buf[MAX_MESSAGE_SIZE];

static int endpoint_id;

int rpmsg_cb(struct rpmsg_endpoint *ept, void *data, size_t len, uint32_t src,
             void *priv)
{
    if (len == 0)
    {
        return RPMSG_SUCCESS;
    }
    /* Fill IPC message struct */
    struct message *msg = message_from_buffer(data, len);
    if (msg == NULL)
    {
        LOG_INF("Failed to parse msg.");
        return RPMSG_ERR_NO_MEM;
    }

    /* Call callback function with ipc message */
    ipc_receive_cb(msg);

    return RPMSG_SUCCESS;
}

int ipc_send(struct message *msg)
{
    size_t size = message_to_buffer(ipc_send_buf, msg);
    return rpmsg_service_send(endpoint_id, ipc_send_buf, size);
}

/* Register endpoint before RPMsg Service is initialized. */
int register_endpoint(const struct device *arg)
{
    int status;
    status = rpmsg_service_register_endpoint("mesh_node", rpmsg_cb);

    if (status < 0)
    {
        LOG_ERR("Registering endpoint failed with %d", status);
        return status;
    }

    endpoint_id = status;

    LOG_INF("RPMsg service registered. Endpoint id: %d", endpoint_id);

    return 0;
}

SYS_INIT(register_endpoint, POST_KERNEL, CONFIG_RPMSG_SERVICE_EP_REG_PRIORITY);
```

## src/node.c
```c
#include <stdint.h>
#include <stdio.h>

#include <common.h>
#include <message.h>

#include <hash.h>
#include <ipc.h>
#include <node.h>
#include <radio.h>

#include <logging/log.h>
#include <logging/log_ctrl.h>
#include <zephyr.h>
LOG_MODULE_REGISTER(node, GLOBAL_LOG_LEVEL);

/* Thread definitions */
#define THREAD_STACK_SIZE 2048
#define THREAD_PRIORITY 5

/* Queue of incoming messages waiting to be processed */
K_MSGQ_DEFINE(node_msgq, sizeof(struct message *), 10, 4);

#define MAX_HOP_COUNT 2

uint8_t msg_count = 0;

uint8_t node_send_buf[MAX_MESSAGE_SIZE];

uint8_t node_addr[MAC_LEN];

uint8_t node_broadcast_addr[MAC_LEN] = {[0 ... MAC_LEN - 1] = 0xff};

void node_enqueue(struct message *msg)
{
    while (k_msgq_put(&node_msgq, &msg, K_NO_WAIT) != 0)
    {
        /* message queue is full: purge old data & try again */
        k_msgq_purge(&node_msgq);
    }
}

int node_radio_send(struct message *msg)
{
    size_t size = message_to_buffer(node_send_buf, msg);
    message_free(msg);
    return radio_send(node_send_buf, size);
}

void node_process_packet()
{
    struct message *msg;
    k_msgq_get(&node_msgq, &msg, K_FOREVER);

    uint32_t hash = hash_packet(msg);

    if (hash_contains(hash))
    {
        message_free(msg);
        return;
    }

    hash_add(hash);

    if (memcmp(msg->dst_mac, node_addr, MAC_LEN) == 0)
    {
        node_receive(msg);
        message_free(msg);
        return;
    }

    if (memcmp(msg->dst_mac, node_broadcast_addr, MAC_LEN) == 0 &&
        memcmp(msg->original_src_mac, node_addr, MAC_LEN) != 0)
    {
        node_receive(msg);
    }

    if (msg->ttl <= 0)
    {
        message_free(msg);
        return;
    }

    msg->ttl--;
    memcpy(msg->src_mac, node_addr, MAC_LEN);

    LOG_HEXDUMP_DBG(msg->payload, msg->payload_len, "Forwarding");
    node_radio_send(msg);
}

int node_send(struct message *msg)
{
    if (msg->payload_len > MAX_PAYLOAD_SIZE)
    {
        return -1;
    }
    memcpy(msg->src_mac, node_addr, MAC_LEN);
    memcpy(msg->original_src_mac, node_addr, MAC_LEN);
    msg->msg_number = msg_count++;
    msg->ttl = MAX_HOP_COUNT;

    hash_add(hash_packet(msg));

    return node_radio_send(msg);
}

void node_thread(void *p1, void *p2, void *p3)
{
    LOG_INF("Node thread started with id %04x", (uint32_t)k_current_get());
    k_msleep(500);

    while (true)
    {
        node_process_packet();
    }
}

void init_node()
{
    for (size_t i = 0; i < MAC_LEN; i++)
    {
        node_addr[i] = NRF_FICR->DEVICEADDR[i / 4] >> ((i % 4) * 8);
    }
    LOG_HEXDUMP_INF(node_addr, MAC_LEN, "Node Address");

    init_hash();
}

K_THREAD_DEFINE(node, THREAD_STACK_SIZE, node_thread, NULL, NULL, NULL, THREAD_PRIORITY, 0, 0);
```

## src/radio.c
```c
#include <logging/log.h>
#include <logging/log_ctrl.h>
#include <zephyr.h>

#include <hal/nrf_radio.h>
#include <nrfx.h>

#include <common.h>
#include <message.h>

#include <radio.h>

LOG_MODULE_REGISTER(radio, GLOBAL_LOG_LEVEL);

/* Radio TX power */
#define TX_POWER NRF_RADIO_TXPOWER_0DBM

/* Radio buffer offsets */
#define RF_BUFFER_LENGTH_OFFSET 0
#define RF_BUFFER_PAYLOAD_OFFSET 1

/* Thread definitions */
#define THREAD_STACK_SIZE 2048
#define THREAD_PRIORITY 5

/* Radio transmission buffer. +1 byte for length byte. */
uint8_t rf_tx_buf[MAX_MESSAGE_SIZE + 1];
/* Radio receive buffer */
uint8_t rf_rx_buf[MAX_MESSAGE_SIZE + 1];

/* Binary semaphore for accessing radio for a transmission */
struct k_sem rf_tx_completed;
/* Semaphore for received packets */
struct k_sem rf_rx_sem;

/* Declaration of trigger functions */
void trigger_rx();
void trigger_tx();

/**
 * @brief Start radio transmission
 */
int radio_send(uint8_t *data, size_t length)
{
    int ret = 0;
    /* Fill radio transmission buffer */
    memcpy(rf_tx_buf + RF_BUFFER_PAYLOAD_OFFSET, data, length);
    /* Set length */
    rf_tx_buf[RF_BUFFER_LENGTH_OFFSET] = length + 1;

    LOG_HEXDUMP_DBG(rf_tx_buf, length + 1, "Data TX");

    /* Get radio state */
    nrf_radio_state_t state = nrf_radio_state_get(NRF_RADIO);
    switch (state)
    {
    case NRF_RADIO_STATE_RX:
        /* Stop RX, trigger TXEN task from RXIDLE state */
        nrf_radio_task_trigger(NRF_RADIO, NRF_RADIO_TASK_STOP);
        trigger_tx();
        break;
    case NRF_RADIO_STATE_RXIDLE:
    case NRF_RADIO_STATE_DISABLED:
        /* Radio already in compatible state, trigger TXEN task */
        trigger_tx();
        break;
    case NRF_RADIO_STATE_TXIDLE:
        nrf_radio_packetptr_set(NRF_RADIO, rf_tx_buf);
        nrf_radio_task_trigger(NRF_RADIO, NRF_RADIO_TASK_START);
        break;
    default:
        /* Radio in incompatible state. Drop packet, for now */
        LOG_ERR("TX Failed, incompatible state. State: %d", state);
        k_sem_give(&rf_tx_completed);
        ret = -EIO;
    }
    k_sem_take(&rf_tx_completed, K_FOREVER);
    LOG_DBG("Finished TX");
    return ret;
}

/**
 * @brief Radio RX thread
 *
 * Forwards messages from radio layer
 */
void radio_rx_thread(void *p1, void *p2, void *p3)
{
    k_msleep(500);
    LOG_INF("Radio RX thread started, ID: %04x", (uint32_t)k_current_get());

    while (true)
    {
        /* Wait for received frame from radio */
        k_sem_take(&rf_rx_sem, K_FOREVER);
        uint8_t length = rf_rx_buf[RF_BUFFER_LENGTH_OFFSET] - 1;
        if (length > MAX_MESSAGE_SIZE)
        {
            length = MAX_MESSAGE_SIZE;
        }
        struct message *msg = message_from_buffer(rf_rx_buf + RF_BUFFER_PAYLOAD_OFFSET, length);
        if (msg == NULL)
        {
            LOG_INF("Failed to parse message.");
            continue;
        }

        /* Callback function for received radio frame */
        radio_receive_cb(msg);
    }
}

/**
 * @brief Set packet pointer and trigger RXEN task
 */
void trigger_rx()
{
    nrf_radio_packetptr_set(NRF_RADIO, rf_rx_buf);
    nrf_radio_task_trigger(NRF_RADIO, NRF_RADIO_TASK_RXEN);
}

/**
 * @brief Set packet pointer and trigger TXEN task
 */
void trigger_tx()
{
    nrf_radio_packetptr_set(NRF_RADIO, rf_tx_buf);
    nrf_radio_task_trigger(NRF_RADIO, NRF_RADIO_TASK_TXEN);
}

/**
 * @brief Radio interrupt handler
 */
void radio_irq_handler(void *ctx)
{
    LOG_DBG("Radio IRQ");
    /* END event. Either TX or RX complete. */
    if (nrf_radio_event_check(NRF_RADIO, NRF_RADIO_EVENT_END))
    {
        nrf_radio_event_clear(NRF_RADIO, NRF_RADIO_EVENT_END);

        nrf_radio_state_t state = nrf_radio_state_get(NRF_RADIO);
        if (NRF_RADIO_STATE_RXIDLE == state)
        {
            /* RX Complete */
            if (nrf_radio_crc_status_check(NRF_RADIO))
            {
                k_sem_give(&rf_rx_sem);
            }
            /* Start new RX, we are already ramped up */
            nrf_radio_task_trigger(NRF_RADIO, NRF_RADIO_TASK_START);
        }
        else if (NRF_RADIO_STATE_TXIDLE == state)
        {
            /* TX Complete */
            /* Return to RX mode */
            trigger_rx();
            /* Give radio tx semaphore */
            k_sem_give(&rf_tx_completed);
        }
        else
        {
            /* Really shouldn't happen! */
            LOG_ERR("Unknown radio state in IRQ: %d", state);
        }
    }
    LOG_DBG("Radio IRQ finished");
}

/**
 * @brief Enable radio interrupts
 */
void init_irq()
{
    int32_t ints_to_enable = 0;
    ints_to_enable |= NRF_RADIO_INT_END_MASK;
    nrf_radio_int_enable(NRF_RADIO, ints_to_enable);
    NVIC_ClearPendingIRQ(RADIO_IRQn);
    NVIC_EnableIRQ(RADIO_IRQn);
    IRQ_CONNECT(RADIO_IRQn, 7, radio_irq_handler, NULL, 0);
}

/**
 * @brief Initialize BLE radio
 */
void init_radio()
{
    LOG_INF("Initializing radio");
    k_sem_init(&rf_tx_completed, 0, 1);
    k_sem_init(&rf_rx_sem, 0, 1);

    /* Set modulation and bitrate */
    nrf_radio_mode_set(NRF_RADIO, NRF_RADIO_MODE_BLE_2MBIT);
    /* Enable fast ramp up, transmit center when idle */
    nrf_radio_modecnf0_set(NRF_RADIO, true, RADIO_MODECNF0_DTX_Center);

    /* Set channel */
    nrf_radio_frequency_set(NRF_RADIO, 2442); // 2442 Mhz

    /* Set radio transmission power */
    nrf_radio_txpower_set(NRF_RADIO, TX_POWER);

    /* Set packet config */
    nrf_radio_packet_conf_t pkt_conf = {
        .lflen = 8UL, // Length field length in bits
        .s0len = 0UL,
        .s1len = 0UL,
        .s1incl = false,
        .plen = NRF_RADIO_PREAMBLE_LENGTH_16BIT,
        .crcinc = false, // CRC included in length field
        .statlen = 0UL,
        .balen = 4UL,
        .big_endian = true,
        .maxlen = MAX_MESSAGE_SIZE, // Max payload length
        .whiteen = false            // Packet whitening
    };
    nrf_radio_packet_configure(NRF_RADIO, &pkt_conf);

    /* Address */
    nrf_radio_base0_set(NRF_RADIO, 0xDEADBEEFUL);
    nrf_radio_prefix0_set(NRF_RADIO, 0x42U);
    nrf_radio_txaddress_set(NRF_RADIO, 0x00U);   // Transmit using logical address 0 (base0 and prefix0)
    nrf_radio_rxaddresses_set(NRF_RADIO, 0x01U); // Enable RX of logical address 0

    /* CRC Config */
    nrf_radio_crc_configure(NRF_RADIO,
                            2, // 2 byte CRC
                            NRF_RADIO_CRC_ADDR_INCLUDE,
                            0x1021); // Polynomial: x16 + x12 + x5 + 1

    /* Shortcuts */
    nrf_radio_shorts_enable(NRF_RADIO, NRF_RADIO_SHORT_READY_START_MASK); // Ready -> Start shortcut

    /* Enable interrupts */
    init_irq();

    /* Start rx */
    trigger_rx();
}

/* Define and start radio rx thread */
K_THREAD_DEFINE(radio_rx, THREAD_STACK_SIZE, radio_rx_thread, NULL, NULL, NULL, THREAD_PRIORITY, 0, 0);
```
