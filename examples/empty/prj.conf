## prj.conf
```kconfig
# Logging
CONFIG_LOG=y

# Enable network core
CONFIG_BOARD_ENABLE_CPUNET=y

# Mesh access module
CONFIG_MESH_ACCESS_MODULE=y
CONFIG_HEAP_MEM_POOL_SIZE=512
```

## src/main.c
```c
#include <stdint.h>
#include <stdio.h>

#include <mesh.h>

void main(void)
{
    init_mesh();
}

void mesh_receive(uint8_t *data, size_t len, uint8_t *src, bool broadcast)
{
}
```
