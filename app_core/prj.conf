## CMakeLists.txt
```
cmake_minimum_required(VERSION 3.8.2)

set(NRF_SUPPORTED_BOARDS
    nrf5340pdk_nrf5340_cpuapp
    nrf5340pdk_nrf5340_cpunet
)

find_package(Zephyr REQUIRED HINTS $ENV{ZEPHYR_BASE})
project(NONE)

target_include_directories(app PRIVATE
    include
)
FILE(GLOB app_sources src/*.c)
target_sources(app PRIVATE
    ${app_sources}
)
```

## prj.conf
```kconfig
# NRFX
CONFIG_NRFX_POWER=y
CONFIG_NRFX_CLOCK=y
CONFIG_NRFX_TIMER0=y

# Logging
CONFIG_LOG=y

# IPC
CONFIG_IPM=y
CONFIG_RPMSG_SERVICE=y
CONFIG_RPMSG_SERVICE_MODE_REMOTE=y
CONFIG_HEAP_MEM_POOL_SIZE=512
CONFIG_OPENAMP_MASTER=n

#CONFIG_OPENAMP=y
#
#CONFIG_IPM=y
#CONFIG_IPM_NRFX=y
#
#CONFIG_IPM_MSG_CH_1_ENABLE=y
#CONFIG_IPM_MSG_CH_1_TX=y
#CONFIG_IPM_MSG_CH_0_ENABLE=y
#CONFIG_IPM_MSG_CH_0_RX=y
#
#CONFIG_HEAP_MEM_POOL_SIZE=4096
```

## src/main.c
```c
#include <stdio.h>
#include <stdint.h>
#include <stdbool.h>
#include <stddef.h>

#include <zephyr.h>
#include <arch/cpu.h>
#include <sys/byteorder.h>
#include <logging/log.h>
#include <drivers/ipm.h>

#include <sys/util.h>
#include <logging/log.h>
#include <logging/log_ctrl.h>

#include <common.h>

#include <openamp/open_amp.h>
#include <metal/sys.h>
#include <metal/device.h>
#include <metal/alloc.h>

#include <ipc/rpmsg_service.h>

#include <nrfx.h>
#include <nrfx_clock.h>
#include <nrfx_power.h>

LOG_MODULE_REGISTER(main, GLOBAL_LOG_LEVEL);

static int endpoint_id;

/**
 * @brief Initialize power and clock peripherals
 */
static void init_power_clock(void)
{
    nrfx_clock_init(NULL);
    nrfx_power_init(NULL);
    nrfx_clock_start(NRF_CLOCK_DOMAIN_HFCLK);
    nrfx_clock_start(NRF_CLOCK_DOMAIN_LFCLK);
    while (!(nrfx_clock_hfclk_is_running() &&
            nrfx_clock_lfclk_is_running()))
    {
        /* Just waiting */
    }
}

int rpmsg_cb(struct rpmsg_endpoint *ept, void *data, size_t len, uint32_t src, 
        void *priv)
{
    LOG_INF("Received rpmsg message. Length: %d", len);

    return RPMSG_SUCCESS;
}

void main(void)
{
    init_power_clock();
    LOG_INF("Power and clock initialized");

    LOG_INF("Mesh node on app core started.");

    uint8_t msg[64];
    sprintf(msg, "Hello");
    
    k_msleep(2000); // Allow logs time to flush

    while(1)
    {
        k_msleep(2000);
        rpmsg_service_send(endpoint_id, msg, 5);
    }

}

/* Make sure we register endpoint before RPMsg Service is initialized. */
int register_endpoint(const struct device *arg)
{
    int status;
    status = rpmsg_service_register_endpoint("mesh_node", rpmsg_cb);

    if (status < 0) {
        LOG_ERR("Registering endpoint failed with %d", status);
        return status;
    }

    endpoint_id = status;

    LOG_INF("RPMsg service registered. Endpoint id: %d", endpoint_id);

    return 0;
}

SYS_INIT(register_endpoint, POST_KERNEL, CONFIG_RPMSG_SERVICE_EP_REG_PRIORITY);
```

## include/common.h
```c
#define GLOBAL_LOG_LEVEL LOG_LEVEL_DBG

#define MAX_MESSAGE_SIZE 255
```

## include/ipc.h
```c
#include <net/buf.h>

/**
 * @brief Initialize RPMsg
 */
int rpmsg_platform_init(void);

/**
 * @brief Send message using RPMsg
 */
int rpmsg_platform_send(struct net_buf_simple *buf, size_t len);

/**
 * @brief RPMsg receive callback
 */
void rpmsg_rx(uint8_t *data, size_t len);
```
